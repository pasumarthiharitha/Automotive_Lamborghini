AUTOSAR XML (schema 00050)
package /ARRoot
  ecu instance ECUInstancePowerWindow
    can communication controller SeatHeatingLeftCanCommunicationController
    can communication connector SeatHeatingCanCommunicationConnector: comm-controller=SeatHeatingLeftCanCommunicationController
  can cluster PowerWindowCanCluster
    can physical channel PowerWindowCanPhysicalChannel: comm-connectors=SeatHeatingCanCommunicationConnector
  flat map PowerWindowFlatMap: instances=flat-instance-descriptor=PowerWindowSystem.PowerWindowRootSoftwareComposition.HeatingElementLeft
  system PowerWindowSystem
    system mapping PowerWindowSoftwareMapping
      sw-impl-mappings:
        swc to impl mapping PowerWindowSwcToImpMapping
      sw-mappings:
        swc to ecu mapping PowerWindowSwcToEcuMapping: component=PowerWindowRootSoftwareComposition.PowerWindowSwComponentProto.PowerWindowSwComponentProto, controlled-hw-element=/ARRoot/, ecu-instance=ECUInstancePowerWindow, processing-unit=/ARRoot/
    root-software-compositions:
      root sw composition prototype PowerWindowRootSoftwareComposition: software-composition=PowerWindowTopLevelComposition
  composition sw component type PowerWindowTopLevelComposition
    component PowerWindowSwComponentProto
    delegation sw connector PowerWindowConnectorProto: outer-port=HeatingElementLeft
